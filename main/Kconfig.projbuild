## main/Kconfig.projbuild
```kconfig
menu "Example Configuration"

config WIFI_SSID
    string "WiFi SSID"
    default "4G-Gateway-E6F8-5G"
    help
        SSID (network name) for the example to connect to.

config WIFI_PASSWORD
    string "WiFi Password"
    default "EE5NTMT4TGB"
    help
        WiFi password (WPA or WPA2) for the example to use.

config BROKER_URL
    string "Broker URL"
    default "mqtt://szorme:advfghmk@192.168.8.100:1883"
    help
        URL of the broker to connect to

config BROKER_URL_FROM_STDIN
    bool
    default y if BROKER_URL = "FROM_STDIN"

endmenu
```
